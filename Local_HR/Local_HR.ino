/*
 *** English version under construction *** 
 *  For more information feel free to contact me
 
  Timski projekt: e-Pulse
  Osnovni program za lokalno citanje pulsa na OLED monitoru (128x64)
  koristeci Adafruit library Adafruit_SSD1306.h za upravljanjem monitorom
  ta SparkFun library MAX30105 za upravljanje height senzorom

  NodeMCU platforma te height i OLED monochrome zaslon (128x64)
*/

//Ukljucimo sve za MAX senzor
#include <Adafruit_SSD1306.h> //OLED library
#include <Wire.h>             //I2C library
#include "MAX30105.h"         //height library
#include "heartRate.h"        //Algoritam za detektiranje otkucaja

//Definiramo ekran
#define width 128    // OLED monitor sirina u pixelima
#define height 64    // OLED monitor visina u pixelima
#define OLED_RESET 2 // Reset pin (...ili BUILTIN_LED)

MAX30105 max30102;          //Definiramo naziv senzora

//Varijable za heartRate.h library
const byte RATE_SIZE = 4;     //Broj posljednjih uzoraka. 4 je dobro
byte rates[RATE_SIZE];        //Niz za otkucaje srca
byte rateSpot = 0;            //Brojac
long lastBeat = 0;            //Vrijeme zadnjeg otkucaja
float bpm;                    //Spremamo otkucaje po minuti
int beatAvg;                  //Spremamo izracunati prosjecan puls

//Definiramo monitor
Adafruit_SSD1306 monitor(width, height, &Wire, OLED_RESET); //Definiramo naziv monitora

//Boot logo spremamo u flash memoriju, ne u SRAM
static const unsigned char PROGMEM boot_logo_bmp[] =
{
  0x00, 0x00, 0x00, 0x00, 0x00, 0x00, 0x00, 0x00, 0x00, 0x00, 0x00, 0x00, 0x00, 0x00, 0x00, 0x00,
  0x00, 0x00, 0x00, 0x00, 0x00, 0x00, 0x00, 0x00, 0x00, 0x00, 0x00, 0x00, 0x00, 0x00, 0x00, 0x00,
  0x00, 0x00, 0x00, 0x00, 0x00, 0x00, 0x00, 0x00, 0x00, 0x00, 0x00, 0x00, 0x00, 0x00, 0x00, 0x00,
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  0x00, 0x00, 0x00, 0x00, 0x00, 0x00, 0x00, 0x00, 0x00, 0x00, 0x00, 0x00, 0x00, 0x00, 0x00, 0x00
};

//Slika bez pulsa
static const unsigned char PROGMEM nema_pulsa_bmp[] =
{ 0x03, 0xC0, 0xF0, 0x06, 0x71, 0x8C, 0x0C, 0x1B, 0x06, 0x18, 0x0E, 0x02, 0x10, 0x0C, 0x03, 0x10,
  0x04, 0x01, 0x10, 0x04, 0x01, 0x10, 0x40, 0x01, 0x10, 0x40, 0x01, 0x10, 0xC0, 0x03, 0x08, 0x88,
  0x02, 0x08, 0xB8, 0x04, 0xFF, 0x37, 0x08, 0x01, 0x30, 0x18, 0x01, 0x90, 0x30, 0x00, 0xC0, 0x60,
  0x00, 0x60, 0xC0, 0x00, 0x31, 0x80, 0x00, 0x1B, 0x00, 0x00, 0x0E, 0x00, 0x00, 0x04, 0x00,
};
//Slika bez pulsa
static const unsigned char PROGMEM nema_pulsa_bmp[] =
{ 0x03, 0xC0, 0xF0, 0x06, 0x71, 0x8C, 0x0C, 0x1B, 0x06, 0x18, 0x0E, 0x02, 0x10, 0x0C, 0x03, 0x10,
  0x04, 0x01, 0x10, 0x04, 0x01, 0x10, 0x40, 0x01, 0x10, 0x40, 0x01, 0x10, 0xC0, 0x03, 0x08, 0x88,
  0x02, 0x08, 0xB8, 0x04, 0xFF, 0x37, 0x08, 0x01, 0x30, 0x18, 0x01, 0x90, 0x30, 0x00, 0xC0, 0x60,
  0x00, 0x60, 0xC0, 0x00, 0x31, 0x80, 0x00, 0x1B, 0x00, 0x00, 0x0E, 0x00, 0x00, 0x04, 0x00,
};

//Slika kad se detektira puls
static const unsigned char PROGMEM ima_pulsa_bmp[] =
{ 0x01, 0xF0, 0x0F, 0x80, 0x06, 0x1C, 0x38, 0x60, 0x18, 0x06, 0x60, 0x18, 0x10, 0x01, 0x80, 0x08,
  0x20, 0x01, 0x80, 0x04, 0x40, 0x00, 0x00, 0x02, 0x40, 0x00, 0x00, 0x02, 0xC0, 0x00, 0x08, 0x03,
  0x80, 0x00, 0x08, 0x01, 0x80, 0x00, 0x18, 0x01, 0x80, 0x00, 0x1C, 0x01, 0x80, 0x00, 0x14, 0x00,
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  0x00, 0x08, 0x10, 0x00, 0x00, 0x06, 0x60, 0x00, 0x00, 0x03, 0xC0, 0x00, 0x00, 0x01, 0x80, 0x00
};

void setup() {
  //Inicijalizacija ekrana
  monitor.begin(SSD1306_SWITCHCAPVCC, 0x3C); //Upali ekran na adresi 0x3C
  monitor.clearDisplay();                    //Ocisti ekran
  
  // monitor.drawBitmap(x,y, naziv bitmap-a, irina slike, visina slike, boja)
  monitor.drawBitmap(0, 0, boot_logo_bmp, 128, 64, WHITE);    //Ispisuje boot sliku
  monitor.display();
  delay(2000);

  // Inicijaliziranje MAX senzora
  max30102.begin(Wire, I2C_SPEED_FAST);  //Koristi zadani I2C port, 400kHz brzina
  max30102.setup();                      //Konfigurira max30102 sa zadanim postavkama - bez ne funkcionira nita
}

void loop() {
  long irValue = max30102.getIR();    // Vrijednost IR-a nan govori kolko je udaljen, odnosno jel prst uopce prisutan

  //Ako je prst tu pocni mirit
  if (irValue > 50000) {             //Ako je IR veci od 50000 (sta veci to je prst bliže)
    monitor.clearDisplay();          //Ociti ekran
    monitor.drawBitmap(5, 21, nema_pulsa_bmp, 24, 21, WHITE); //Nacrtaj da nema pulsa
    monitor.setTextSize(1);         //Velicina fonta
    monitor.setTextColor(WHITE);    //Ekran je crn pa upali pixele
    monitor.setCursor(40, 5);       //Pocni pisat na x,y koordinatama
    monitor.println("e-Pulse");     //Ispisi tekst
    monitor.setTextSize(2);
    monitor.setCursor(50, 16);
    monitor.println("Puls");
    monitor.setCursor(50, 34);
    monitor.println(beatAvg);      //Ispisi puls
    monitor.display();             //Ispisi sve iz RAM memorije ↑

    if (checkForBeat(irValue) == true)  //Ako prepozna otkucaj
    {
      monitor.clearDisplay();
      monitor.drawBitmap(0, 16, ima_pulsa_bmp, 32, 32, WHITE); //Nacrtaj da ima pulsa
      monitor.setTextSize(1);
      monitor.setTextColor(WHITE);
      monitor.setCursor(40, 5);
      monitor.println("e-Pulse");
      monitor.setTextSize(2);
      monitor.setCursor(50, 16);
      monitor.println("Puls");
      monitor.setCursor(50, 34);
      monitor.println(beatAvg);
      monitor.display();

      //Kad se pripozna otkucaj
      long delta = millis() - lastBeat;   //Miri vrime između dva otkucaja
      lastBeat = millis();                //Bilježi vrime trenutnog/zadnjeg otkucaja

      bpm = 60 / (delta / 1000.0);   //Izracunavanje pulsa

      if (bpm < 255 && bpm > 20)    //Da bi izracunali prosjek spremamo RATE_SIZE (4) posljednje vrijednosti
      {
        rates[rateSpot++] = (byte)bpm;           //Spremi u niz
        rateSpot %= RATE_SIZE;                   //Zaokruži vrijednost


        //Izracunaj prosjek
        beatAvg = 0;
        for (byte x = 0 ; x < RATE_SIZE ; x++)
          beatAvg += rates[x];
        beatAvg /= RATE_SIZE;
      }
    }
  }

  if (irValue < 7000) {               //Ako nema prsta
    beatAvg = 0;                      //Resetira izracun pulsa na 0
    monitor.clearDisplay();
    monitor.setTextSize(1);
    monitor.setTextColor(WHITE);
    monitor.setCursor(40, 5);
    monitor.println("e-Pulse");
    monitor.setTextSize(2);
    monitor.setCursor(5, 21);
    monitor.println("Prislonite");
    monitor.setCursor(40, 38);
    monitor.println("prst");
    monitor.display();
  }
}
